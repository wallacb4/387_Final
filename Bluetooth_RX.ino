#include <SoftwareSerial.h>
#include <Wire.h>
#include <SPI.h>
#include <SFE_MicroOLED.h>

//Defining the pins that are used for the OLED screen
#define PIN_RESET 9
#define PIN_DC 8
#define PIN_CS 10
#define DC_JUMPER 0

//Defining the oled object for the MFE_MicroOLED library
MicroOLED oled(PIN_RESET, PIN_DC, PIN_CS);

int info; //The info read directly from the serial port.
int state = 0; //Used for data validation
uint8_t bitmap_sent[384]; // Array to store the hex values sent from computer
//Locally stored version of the bitmap used for data validation
uint8_t bitmap_compare[] = {
  0xFF, 0xFF, 0xFF, 0xFF, 0x7F, 0x3F, 0x1F, 0x0F, 0x0F, 0x07, 0x07, 0x07, 0x83, 0x83, 0x83, 0x83,
  0x83, 0x83, 0x83, 0x03, 0x07, 0x07, 0x0F, 0x0F, 0x1F, 0x1F, 0x3F, 0x7F, 0xFF, 0xFF, 0xFF, 0xFF,
  0xFF, 0xFF, 0xFF, 0xFF, 0x7F, 0x3F, 0x1F, 0x1F, 0x0F, 0x0F, 0x07, 0x07, 0x03, 0x83, 0x83, 0x83,
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  0xFE, 0xF8, 0xE0, 0xC0, 0xC0, 0xFF, 0xFF, 0xF0, 0xE0, 0xC7, 0xCF, 0xCF, 0xC7, 0xE0, 0xF0, 0xFF
};

void setup() {
  Serial.begin(9600); //Starting the serial port with the HC-06's default baud rate of 9600
  bluetooth();
  dataValidation();
  if (state == 1) {
    OLED_display();
  }
}

void loop() {
}

void bluetooth() {
  int i = 0;
  //Reads the serial port until all 384 hex values have been acquired
  while (i < 384)
  {
    info = Serial.read();
    //The logical check is needed, as without it there has been cases where the data stored in info has been incorrect
    if (-1 != info) {
      bitmap_sent[i] = info;
      i++;
    }
  }
}

void dataValidation() {
  int k = 0;
  int j = 0;
  //Going through each value in the sent bitmap and the locally stored one to make sure that they all match
  for (k = 0; k < 384; k++) {
    if (bitmap_sent[k] == bitmap_compare[k]) {
      j++;
    }
    else {
      //If the values don't match this breaks the loop and tells the location and values of the non-matching pair
      Serial.print("Broken ");
      Serial.print(k);
      Serial.println(bitmap_sent[k]);
      Serial.println(bitmap_compare[k]);
      break;
    }
  }

  if (j == 384) {
    //If successful the state is changed to 1, allowing for the bitmap to be displayed
    state = 1;
  }
}

void OLED_display() {
  oled.begin(); //Sends the start signal to the OLED
  oled.clear(ALL); //Clears the 384 local memory locations in the screen and the state of each pixel
  oled.display(); //Updates the state of each pixel from memory
  delay(1000); // The delay is needed due to the screen showing the company logo for the first second after being turned on and updated for the first time

  oled.clear(PAGE); //Clears the memory in the screen
  oled.drawBitmap(bitmap_sent); //Takes the input array and loops through it, sending out each of the values to memory
  oled.display();
  delay(5000);

  oled.clear(ALL);
  delay(1000);
  oled.drawBitmap(bitmap_compare);
  oled.display();
}

